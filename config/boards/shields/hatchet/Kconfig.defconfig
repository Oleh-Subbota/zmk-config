## config/boards/shields/hatchet/Kconfig.defconfig
```kconfig
if SHIELD_HATCHET_LEFT

# Name must be less than 16 characters long!
config ZMK_KEYBOARD_NAME
    default "Hatchet"

config ZMK_SPLIT_ROLE_CENTRAL
    default y

endif

if SHIELD_HATCHET_LEFT || SHIELD_HATCHET_RIGHT

config ZMK_SPLIT
    default y

endif
```

## config/shields/hatchet/Kconfig.shield
```kconfig
config SHIELD_HATCHET_LEFT
    def_bool $(shields_list_contains,hatchet_left)

config SHIELD_HATCHET_RIGHT
    def_bool $(shields_list_contains,hatchet_right)
```
